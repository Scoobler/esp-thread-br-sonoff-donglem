## examples/basic_thread_border_router/sdkconfig.defaults.sonoff_dongle_m
```kconfig
# Sonoff Dongle-M Stage 1 hardware baseline (ESP-IDF v5.5.4)
CONFIG_IDF_TARGET="esp32"

# 16 MB host flash. Conservative DIO/40 MHz works with the verified ESP32 module.
CONFIG_ESPTOOLPY_FLASHSIZE_16MB=y
CONFIG_ESPTOOLPY_FLASHMODE_DIO=y
CONFIG_ESPTOOLPY_FLASHFREQ_40M=y
CONFIG_PARTITION_TABLE_CUSTOM=y
CONFIG_PARTITION_TABLE_CUSTOM_FILENAME="partitions-sonoff-dongle-m.csv"
CONFIG_PARTITION_TABLE_FILENAME="partitions-sonoff-dongle-m.csv"
CONFIG_COMPILER_OPTIMIZATION_SIZE=y
CONFIG_LIBC_NEWLIB_NANO_FORMAT=y
CONFIG_ESP_SYSTEM_EVENT_TASK_STACK_SIZE=3584
CONFIG_ESP_MAIN_TASK_STACK_SIZE=5120

CONFIG_ESP_BR_BOARD_SONOFF_DONGLE_M=y
CONFIG_ESP_CONSOLE_UART_DEFAULT=y
CONFIG_ESP_CONSOLE_UART_NUM=0

# External stock Sonoff EFR32MG24 RCP: UART1, 115200 8N1, no flow control.
CONFIG_OPENTHREAD_ENABLED=y
CONFIG_OPENTHREAD_BORDER_ROUTER=y
CONFIG_OPENTHREAD_RADIO_SPINEL_UART=y
CONFIG_OPENTHREAD_SPINEL_ONLY=y
CONFIG_ESP_BR_RCP_UART_PORT=1
CONFIG_ESP_BR_RCP_UART_BAUDRATE=115200
CONFIG_PIN_TO_RCP_TX=13
CONFIG_PIN_TO_RCP_RX=17
CONFIG_PIN_TO_RCP_RESET=12
CONFIG_PIN_TO_RCP_BOOT=15
CONFIG_OPENTHREAD_RX_ON_WHEN_IDLE=n
CONFIG_OPENTHREAD_TASK_SIZE=8192
CONFIG_OPENTHREAD_RCP_COMMAND=y
CONFIG_OPENTHREAD_CLI_OTA=y
CONFIG_AUTO_UPDATE_RCP=n

# Dongle-M startup policy: Ethernet first, then saved Wi-Fi, then current
# upstream SoftAP provisioning/recovery.
CONFIG_EXAMPLE_CONNECT_WIFI=y
CONFIG_EXAMPLE_CONNECT_ETHERNET=y
CONFIG_EXAMPLE_USE_INTERNAL_ETHERNET=y
CONFIG_EXAMPLE_ETH_PHY_IP101=y
CONFIG_EXAMPLE_ETH_MDC_GPIO=23
CONFIG_EXAMPLE_ETH_MDIO_GPIO=18
CONFIG_EXAMPLE_ETH_PHY_RST_GPIO=5
CONFIG_EXAMPLE_ETH_PHY_ADDR=1
CONFIG_ETH_PHY_INTERFACE_RMII=y
CONFIG_ETH_RMII_CLK_INPUT=y
CONFIG_ETH_RMII_CLK_IN_GPIO=0
CONFIG_OPENTHREAD_BR_AUTO_START=y
CONFIG_OPENTHREAD_BR_START_WEB=y
CONFIG_OPENTHREAD_BR_SOFTAP_SETUP=y
CONFIG_OPENTHREAD_CLI_WIFI=y
CONFIG_EXAMPLE_WIFI_CONN_MAX_RETRY=3

CONFIG_LWIP_IPV6_FORWARD=y
CONFIG_LWIP_IPV6_NUM_ADDRESSES=12
CONFIG_LWIP_MULTICAST_PING=y
CONFIG_LWIP_NETIF_STATUS_CALLBACK=y
CONFIG_LWIP_HOOK_IP6_ROUTE_DEFAULT=y
CONFIG_LWIP_HOOK_ND6_GET_GW_DEFAULT=y
CONFIG_LWIP_HOOK_IP6_INPUT_CUSTOM=y
CONFIG_LWIP_IPV6_AUTOCONFIG=y
CONFIG_LWIP_HOOK_IP6_SELECT_SRC_ADDR_CUSTOM=y
CONFIG_LWIP_FORCE_ROUTER_FORWARDING=y
CONFIG_MBEDTLS_CMAC_C=y
CONFIG_MBEDTLS_SSL_PROTO_DTLS=y
CONFIG_MBEDTLS_KEY_EXCHANGE_ECJPAKE=y
CONFIG_MBEDTLS_ECJPAKE_C=y
CONFIG_MDNS_MULTIPLE_INSTANCE=y
CONFIG_MDNS_MAX_SERVICES=200
CONFIG_HTTPD_MAX_REQ_HDR_LEN=1024
```

## examples/common/thread_border_router/Kconfig.projbuild
```kconfig
menu "ESP Thread Border Router Example"

    choice ESP_BR_BOARD_TYPE
        prompt "Border router board type"
        default ESP_BR_BOARD_STANDALONE
        help
            The board running the border router.

        config ESP_BR_BOARD_STANDALONE
            bool "Standalone dev kits"
            help
                Standalone ESP Wi-Fi dev kit manually connected to the RCP,
                including ESP32-P4-Function-EV-Board

        config ESP_BR_BOARD_DEV_KIT
            bool "Border router dev kit"
            help
                Integrated border router dev kit

        config ESP_BR_BOARD_M5STACK_CORES3
            bool "Border router M5Stack CoreS3"
            help
                M5Stack CoreS3

        config ESP_BR_BOARD_SONOFF_DONGLE_M
            bool "Sonoff Dongle-M"
            depends on IDF_TARGET_ESP32
            select EXAMPLE_CONNECT_ETHERNET
            help
                Sonoff Dongle-M with a classic ESP32 host, an IP101GA RMII
                Ethernet PHY, and an external EFR32MG24 RCP over UART.
    endchoice

    menu "Board Configuration"
        config PIN_TO_RCP_RESET
            int "Pin to RCP reset"
            default 12 if ESP_BR_BOARD_SONOFF_DONGLE_M
            default 7 if ESP_BR_BOARD_DEV_KIT
            default 7 if ESP_BR_BOARD_STANDALONE
            default 7 if ESP_BR_BOARD_M5STACK_CORES3

        config PIN_TO_RCP_BOOT
            int "Pin to RCP boot"
            default 15 if ESP_BR_BOARD_SONOFF_DONGLE_M
            default 8 if ESP_BR_BOARD_DEV_KIT
            default 8 if ESP_BR_BOARD_STANDALONE
            default 18 if ESP_BR_BOARD_M5STACK_CORES3

        config PIN_TO_RCP_TX
            int "Pin to RCP TX"
            default 13 if ESP_BR_BOARD_SONOFF_DONGLE_M
            default 17 if ESP_BR_BOARD_DEV_KIT
            default 4 if ESP_BR_BOARD_STANDALONE
            default 10 if ESP_BR_BOARD_M5STACK_CORES3

        config PIN_TO_RCP_RX
            int "Pin to RCP RX"
            default 17 if ESP_BR_BOARD_SONOFF_DONGLE_M
            default 18 if ESP_BR_BOARD_DEV_KIT
            default 5 if ESP_BR_BOARD_STANDALONE
            default 17 if ESP_BR_BOARD_M5STACK_CORES3

        config PIN_TO_RCP_CS
            depends on OPENTHREAD_RADIO_SPINEL_SPI
            int "Pin to RCP SPI CS"
            default 10 if ESP_BR_BOARD_DEV_KIT
            default 20 if ESP_BR_BOARD_STANDALONE
            default 13 if ESP_BR_BOARD_M5STACK_CORES3

        config PIN_TO_RCP_SCLK
            depends on OPENTHREAD_RADIO_SPINEL_SPI
            int "Pin to RCP SPI SCLK"
            default 12 if ESP_BR_BOARD_DEV_KIT
            default 22 if ESP_BR_BOARD_STANDALONE
            default 36 if ESP_BR_BOARD_M5STACK_CORES3

        config PIN_TO_RCP_MISO
            depends on OPENTHREAD_RADIO_SPINEL_SPI
            int "Pin to RCP SPI MISO"
            default 13 if ESP_BR_BOARD_DEV_KIT
            default 23 if ESP_BR_BOARD_STANDALONE
            default 35 if ESP_BR_BOARD_M5STACK_CORES3

        config PIN_TO_RCP_MOSI
            depends on OPENTHREAD_RADIO_SPINEL_SPI
            int "Pin to RCP SPI MOSI"
            default 11 if ESP_BR_BOARD_DEV_KIT
            default 21 if ESP_BR_BOARD_STANDALONE
            default 37 if ESP_BR_BOARD_M5STACK_CORES3

        config ESP_BR_RCP_UART_PORT
            int "RCP UART port"
            range 0 2
            default 1
            depends on OPENTHREAD_RADIO_SPINEL_UART

        config ESP_BR_RCP_UART_BAUDRATE
            int "RCP UART baud rate"
            range 9600 2000000
            default 115200 if ESP_BR_BOARD_SONOFF_DONGLE_M
            default 460800
            depends on OPENTHREAD_RADIO_SPINEL_UART

        if ESP_BR_BOARD_SONOFF_DONGLE_M
            config ESP_BR_DONGLE_M_ETHERNET_WAIT_MS
                int "Dongle-M Ethernet startup wait (ms)"
                default 10000
                range 1000 60000
            config ESP_BR_DONGLE_M_WIFI_WAIT_MS
                int "Dongle-M Wi-Fi startup wait (ms)"
                default 12000
                range 1000 60000
            config ESP_BR_DONGLE_M_WIFI_FAIL_THRESHOLD
                int "Dongle-M Wi-Fi failure threshold"
                default 5
                range 1 20
            config ESP_BR_DONGLE_M_SOFTAP_WINDOW_MS
                int "Dongle-M provisioning SoftAP window (ms)"
                default 180000
                range 10000 600000
            config ESP_BR_DONGLE_M_ETHERNET_FAILURE_CONFIRM_MS
                int "Dongle-M Ethernet failure confirmation (ms)"
                default 5000
                range 1000 60000
            config ESP_BR_DONGLE_M_ETHERNET_RECOVERY_STABLE_MS
                int "Dongle-M Ethernet recovery stability (ms)"
                default 30000
                range 1000 300000
            config ESP_BR_DONGLE_M_LED_PULSE_INTERVAL_MS
                int "Dongle-M LED pulse interval (ms)"
                default 2000
                range 250 60000
            config ESP_BR_DONGLE_M_LED_PULSE_DURATION_MS
                int "Dongle-M LED pulse duration (ms)"
                default 200
                range 50 5000
            config ESP_BR_DONGLE_M_LED_DETACHED_SUPPRESS_MS
                int "Dongle-M detached LED suppression after OT ready (ms)"
                default 15000
                range 0 120000
            config ESP_BR_BOARD_MG24_RESET_GPIO
                int
                default 12
            config ESP_BR_BOARD_MG24_CONTROL_GPIO
                int
                default 15
            config ESP_BR_BOARD_LED_RED_GPIO
                int
                default 4
            config ESP_BR_BOARD_LED_GREEN_GPIO
                int
                default 14
            config ESP_BR_BOARD_LED_BLUE_GPIO
                int
                default 2
            config ESP_BR_BOARD_ETH_MDC_GPIO
                int
                default 23
            config ESP_BR_BOARD_ETH_MDIO_GPIO
                int
                default 18
            config ESP_BR_BOARD_ETH_RESET_GPIO
                int
                default 5
            config ESP_BR_BOARD_ETH_PHY_ADDR
                int
                default 1
            config ESP_BR_BOARD_ETH_RMII_CLK_GPIO
                int
                default 0
            config ESP_BR_BOARD_ETH_RMII_TX_EN_GPIO
                int
                default 21
            config ESP_BR_BOARD_ETH_RMII_TXD0_GPIO
                int
                default 19
            config ESP_BR_BOARD_ETH_RMII_TXD1_GPIO
                int
                default 22
            config ESP_BR_BOARD_ETH_RMII_RXD0_GPIO
                int
                default 25
            config ESP_BR_BOARD_ETH_RMII_RXD1_GPIO
                int
                default 26
            config ESP_BR_BOARD_ETH_RMII_CRS_DV_GPIO
                int
                default 27
        endif
    endmenu

    choice ESP_BR_RCP_TARGET
        prompt "Border router RCP target"
        depends on AUTO_UPDATE_RCP
        default ESP_BR_H2_TARGET
        help
            The board running the Thread RCP.

        config ESP_BR_H2_TARGET
            bool "ESP32-H2"
            help
                ESP32-H2 RCP 

        config ESP_BR_C6_TARGET
            bool "ESP32-C6"
            help
                ESP32-C6 RCP
    endchoice

    config OPENTHREAD_BR_AUTO_START
        bool 'Enable the automatic start mode in Thread Border Router.'
        default n
        help
            If enabled, The Thread Border Router will connect to Wi-Fi with pre-configured
            SSID and PSK, and then form a Thread network automatically. Otherwise, user need
            to configure Wi-Fi and Thread manually.

    config OPENTHREAD_BR_START_WEB
        bool 'Enable the web server in Thread Border Router.'
        select OPENTHREAD_COMMISSIONER
        select OPENTHREAD_JOINER
        default n
        help
            If enabled, a web server will be provided to configure and query Thread network via a Web GUI.

    config OPENTHREAD_BR_SOFTAP_SETUP
        bool 'Enable SoftAP Wi-Fi configuration mode'
        default n
        help
            If enabled, the border router will start a SoftAP (Access Point) mode when no Wi-Fi
            credentials are found or WiFi connection fails. Users can connect to the AP and
            configure Wi-Fi via a web interface at http://192.168.4.1.

endmenu
```
